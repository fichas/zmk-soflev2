## config/west.yml
```yaml
manifest:
  remotes:
    - name: zmkfirmware
      url-base: https://github.com/zmkfirmware
    - name: roang
      url-base: https://github.com/Roang-zero1
  projects:
    - name: zmk
      remote: roang
      revision: main
      import: app/west.yml
  self:
    path: config
```
